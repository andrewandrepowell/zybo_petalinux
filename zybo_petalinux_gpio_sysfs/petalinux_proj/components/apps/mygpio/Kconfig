## zybo_petalinux_i2c_lcd/petalinux_proj/components/apps/mylcd/Kconfig
```kconfig
###############################################################################
# Please modify this file if you want to configure your own application.
# You can uncommon and/or change the following Kconfig elements.
###############################################################################


if ROOTFS_COMPONENT_APPS_NAME_MYLCD
	config APPS_MYLCD
		bool
		default y
		select ROOTFS_PACKAGES_LIBSTDCPLUSPLUS6
	comment "No additional options for MYLCD"

# 	config APPS_MYLCD_OPTION0
#	bool "option0"
#	help
#	  Help text
endif
```
